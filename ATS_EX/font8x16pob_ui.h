#pragma once
#include <avr/pgmspace.h>
// Pixel Operator Bold, packed: space + - . / 0-9 A-Z (41 glyphs).
// Index via pobIndex(); DCfont first=0 last=40 for oled.write(idx).
const uint8_t ssd1306xled_font8x16pob_ui[] PROGMEM = {
    0x00, 0x00, 0x00, 0x00, 0x00, 0x00, 0x00, 0x00, 0x00, 0x00, 0x00, 0x00, 0x00, 0x00, 0x00, 0x00,
    0x00, 0x00, 0x00, 0xc0, 0xc0, 0x00, 0x00, 0x00, 0x00, 0x01, 0x01, 0x07, 0x07, 0x01, 0x01, 0x00,
    0x00, 0x00, 0x00, 0x00, 0x00, 0x00, 0x00, 0x00, 0x00, 0x00, 0x01, 0x01, 0x01, 0x01, 0x00, 0x00,
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    0x00, 0x10, 0x10, 0x10, 0x90, 0xf0, 0x70, 0x00, 0x00, 0x1c, 0x1e, 0x13, 0x11, 0x10, 0x10, 0x00,
};

const DCfont TinyOLED4kfont8x16pob_ui = {
    (uint8_t *)ssd1306xled_font8x16pob_ui,
    8, 2, 0, 40
};
#define FONT8X16POB_UI (&TinyOLED4kfont8x16pob_ui)

inline uint8_t pobIndex(uint8_t c)
{
    if (c >= 'A' && c <= 'Z')
        return (uint8_t)(15 + (c - 'A'));
    if (c >= 'a' && c <= 'z')
        return (uint8_t)(15 + (c - 'a'));
    if (c >= '0' && c <= '9')
        return (uint8_t)(5 + (c - '0'));
    if (c == ' ')
        return 0;
    if (c == '+')
        return 1;
    if (c == '-')
        return 2;
    if (c == '.')
        return 3;
    if (c == '/')
        return 4;
    return 0;
}
